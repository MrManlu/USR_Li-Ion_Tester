#define IDLE_ITEMS 4

const char *idle_strings[IDLE_ITEMS] = { "IDLE", "Menu ->", "3333333", "abcdefg" };

static unsigned char AMPS_bitmap[] U8G_PROGMEM =
{
  0x3f, 0xff, 0xff, 0xff, 0xff, 0xff, 0xff, 0xfc, 0x60, 0x0, 0x0, 0x0,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 0xff,
  0x80, 0x0, 0x0, 0x0, 0x0, 0x0, 0x1, 0xbb, 0x80, 0x0, 0x0, 0x0,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 0x87,
  0x80, 0x0, 0x0, 0x0, 0x0, 0x0, 0x1, 0xbb, 0x80, 0x0, 0x0, 0x0,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 0xfc
};

static unsigned char VOLTS_bitmap[] U8G_PROGMEM =
{
  0x1f, 0xff, 0xff, 0xff, 0xff, 0xff, 0xff, 0xfc, 0x30, 0x0, 0x0, 0x0,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 0xff,
  0x40, 0x0, 0x0, 0x0, 0x0, 0x0, 0x1, 0xc7, 0x40, 0x0, 0x0, 0x0,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 0xbf,
  0x40, 0x0, 0x0, 0x0, 0x0, 0x0, 0x1, 0xbf, 0x40, 0x0, 0x0, 0x0,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 0xfc
};



void drawIdle(void)
{
  u8g.setFont(u8g_font_unifont);
  u8g.drawStr( 0, 50, "Li-Ion Tester");
  u8g.setFont(u8g_font_6x10);
  u8g.setPrintPos(0, 32);
  u8g.print("\xdalt C med[Ah]="+String(previousCapacity));
  draw_ampBox(0, 0, amps);
  draw_voltBox(64, 0, volt);
  u8g.setFont(u8g_font_6x10);
  u8g.setPrintPos(0, 63);
  u8g.print("fw version: " + String(version));

}

void draw_ampBox(uint8_t x, uint8_t y, float amps)
{
  u8g.drawBitmapP( x, y, 8, 23, AMPS_bitmap);
  u8g.setFont(u8g_font_10x20r);
  u8g.setPrintPos(x + 3, y + 18);
  if (amps > 0)
    u8g.print(" ");
  u8g.print(amps, 1);
}

void draw_voltBox(uint8_t x, uint8_t y, float volts)
{
  u8g.drawBitmapP( x, y, 8, 23, VOLTS_bitmap);
  u8g.setFont(u8g_font_10x20r);
  u8g.setPrintPos(x + 4, y + 18);
  if (volts >= 0)
    u8g.print(" ");
  u8g.print(volts, 2);
}

void Idle_buttons(uint8_t uiKeyCode)
{
  switch ( uiKeyCode ) {
    case KEY_NEXT:
      beep();
      break;
    case KEY_PREV:
      beep();
      break;
    case KEY_SELECT:
      beepOK();
      next_state = MENU;
      break;
    default:
      break;
  }
}

void state_idle(void)
{
  //Serial.println("IDLE");

  digitalWrite(chargingRelay, LOW);
  digitalWrite(dischargingRelay, LOW);
}
