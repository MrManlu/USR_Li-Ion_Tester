#include "U8glib.h"
#include <Encoder.h>
#include <EEPROM.h>
#include <SPI.h>
#include <SD.h>

// setup u8g object, please remove comment from one of the following constructor calls
// IMPORTANT NOTE: The following list is incomplete. The complete list of supported
// devices with all constructor calls is here: https://github.com/olikraus/u8glib/wiki/device

//U8GLIB_ST7920_128X64_1X u8g(8, 9, 10, 11, 4, 5, 6, 7, 18, 17, 16);   // 8Bit Com: D0..D7: 8,9,10,11,4,5,6,7 en=18, di=17,rw=16
//U8GLIB_ST7920_128X64_4X u8g(8, 9, 10, 11, 4, 5, 6, 7, 18, 17, 16);   // 8Bit Com: D0..D7: 8,9,10,11,4,5,6,7 en=18, di=17,rw=16
//U8GLIB_ST7920_128X64_1X u8g(5, 9, 8);	// SPI Com: SCK = en = 18, MOSI = rw = 16, CS = di = 17
//U8GLIB_ST7920_128X64_4X u8g(13, 11, 10);	// SPI Com: SCK = en = 18, MOSI = rw = 16, CS = di = 17
U8GLIB_ST7920_128X64_4X u8g(30);

static unsigned char usr_logo[] = {
  0x0, 0x0, 0x0, 0x0, 0x0, 0x0, 0x0, 0x0, 0x0, 0x0, 0x0, 0x0,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 0x0,
  0x0, 0x7f, 0x0, 0x0, 0x0, 0x0, 0x0, 0x0, 0x0, 0x7, 0xf0, 0x0,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 0x0,
  0x0, 0x0, 0xff, 0xff, 0x80, 0x0, 0x0, 0x0, 0xff, 0xff, 0xff, 0xf8,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 0x0,
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  0x0, 0x0, 0x0, 0x3f, 0xff, 0xff, 0x0, 0x0, 0x7f, 0xff, 0xf8, 0x1,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 0x0
};

Encoder myEnc(3, 2);
#define KEY_NONE 0
#define KEY_PREV 1
#define KEY_NEXT 2
#define KEY_SELECT 3
#define KEY_BACK 4

#define buzzer 5

#define chargingRelay 31
#define dischargingRelay 35
#define sd_card_cs_pin 53

Sd2Card card;
SdVolume volume;
SdFile root;
File dataFile;
String FileName = "";
bool logging = false;

#define volt_analog_pin A2
#define amps_analog_pin A0
#define dch_min_volt 2.5
//#define dch_min_volt 0.5 
#define chg_max_volt 4.2
#define chg_min_amps 1.3
#define muestras 200
#define seconds_to_log 5
#define version "0.1.1"

double volt = 0;
double amps = 0;
double Capacity = 0;
double previousCapacity = 0;
unsigned long previousMillis = 0; // Previous time in ms
unsigned long millisPassed = 0;  // Current time in ms
unsigned long prev_elapsedTime = 0;
unsigned long elapsedTime = 0;
unsigned long millisAtStart = 0;  // Current time in ms

//uint8_t uiKeyPrev = 3;
//uint8_t uiKeyNext = 2;
uint8_t uiKeySelect = 4;
uint8_t uiKeyBack = 6;

uint8_t uiKeyCodeFirst = KEY_NONE;
uint8_t uiKeyCodeSecond = KEY_NONE;
uint8_t uiKeyCode = KEY_NONE;

// Estados
enum states {
  IDLE,
  MENU,
  DIALOG,
  CHARGING,
  CHARGE_OK,
  DISCHARGING,
  DISCHARGE_OK,
} next_state, old_state;

enum events {
  CYCLE,
  CHARGE,
  DISCHARGE,
  STOP,
};

enum events event = STOP;

long oldPosition  = -999;

void uiSetup(void) {
  // configure input keys

  //pinMode(2, INPUT);           // set pin to input with pullup
  //pinMode(3, INPUT);           // set pin to input with pullup
  pinMode(uiKeySelect, INPUT_PULLUP);           // set pin to input with pullup
  pinMode(uiKeyBack, INPUT_PULLUP);           // set pin to input with pullup
}

void uiStep(void) {
  long newPosition = myEnc.read();
  uiKeyCodeSecond = uiKeyCodeFirst;
  //  if ( digitalRead(uiKeyPrev) == LOW )
  //    uiKeyCodeFirst = KEY_PREV;
  //  else if ( digitalRead(uiKeyNext) == LOW )
  //    uiKeyCodeFirst = KEY_NEXT;
  if (newPosition != oldPosition) {
    if (newPosition > oldPosition)
      uiKeyCodeFirst = KEY_NEXT;
    else
      uiKeyCodeFirst = KEY_PREV;
    oldPosition = newPosition;
  }
  else if ( digitalRead(uiKeySelect) == LOW )
    uiKeyCodeFirst = KEY_SELECT;
  else if ( digitalRead(uiKeyBack) == LOW )
    uiKeyCodeFirst = KEY_BACK;
  else
    uiKeyCodeFirst = KEY_NONE;

  if ( uiKeyCodeSecond == uiKeyCodeFirst )
    uiKeyCode = uiKeyCodeFirst;
  else
    uiKeyCode = KEY_NONE;
}

uint8_t menu_redraw_required = 0;
uint8_t last_key_code = KEY_NONE;


void draw(void) {
  switch (next_state)
  {
    case IDLE:
      drawIdle();
      break;
    case MENU:
      drawMenu();
      break;
    case DIALOG:
      drawDialog();
      break;
    case CHARGING:
      drawCharge();
      break;
    case CHARGE_OK:
      drawChargeOK();
      break;
    case DISCHARGING:
      drawDischarge();
      break;
    case DISCHARGE_OK:
      drawDischargeOk();
      break;
    default:
      drawIdle();
      break;
  }
}

void updateMenu(void) {
  if ( uiKeyCode != KEY_NONE && last_key_code == uiKeyCode ) {
    return;
  }
  last_key_code = uiKeyCode;

  switch (old_state)
  {
    case MENU:
      Menu_buttons(uiKeyCode);
      menu_redraw_required = 1;
      break;
    case IDLE:
      Idle_buttons(uiKeyCode);
      menu_redraw_required = 1;
      break;
    case DIALOG:
      Dialog_buttons(uiKeyCode);
      menu_redraw_required = 1;
      break;
    case CHARGING:
      Charge_buttons(uiKeyCode);
      menu_redraw_required = 1;
      break;
    case CHARGE_OK:
      ChargeOk_buttons(uiKeyCode);
      menu_redraw_required = 1;
      break;
    case DISCHARGING:
      Discharge_buttons(uiKeyCode);
      menu_redraw_required = 1;
      break;
    case DISCHARGE_OK:
      DischargeOk_buttons(uiKeyCode);
      menu_redraw_required = 1;
      break;
  }

}


void setup() {
  // rotate screen, if required
  // u8g.setRot180();
  Serial.begin(9600);
  uiSetup();                                // setup key detection and debounce algorithm
  menu_redraw_required = 1;     // force initial redraw
  next_state = IDLE;
  old_state = IDLE;
  pinMode(chargingRelay, OUTPUT);
  digitalWrite(chargingRelay, LOW);
  pinMode(dischargingRelay, OUTPUT);
  digitalWrite(dischargingRelay, LOW);
  Capacity = 0;
  //u8g.setHardwareBackup(u8g_backup_avr_spi);
  //Serial.print(checkSD());
  //Serial.print(sd_volume());
  if (  menu_redraw_required != 0 ) {
    u8g.firstPage();
    do  {
      u8g.drawBitmap(0, 0, 16, 64, usr_logo);
    } while ( u8g.nextPage() );
  }
  delay(3000);
}

void loop() {

  uiStep();                                     // check for key press
  readSensors();

  if (  menu_redraw_required != 0 ) {
    u8g.firstPage();
    do  {
      draw();
    } while ( u8g.nextPage() );
    menu_redraw_required = 0;
  }

  updateMenu();

  old_state = next_state;
  switch (next_state)
  {
    case IDLE:
      EEPROM.get(0, previousCapacity);
      state_idle();
      break;
    case MENU:
      state_menu();
      break;
    case DIALOG:
      state_dialog();
      break;
    case CHARGING:
      state_charge();
      break;
    case CHARGE_OK:
      state_charge_ok();
      break;
    case DISCHARGING:
      state_discharge();
      break;
    case DISCHARGE_OK:
      state_discharge_ok();
      break;
    default:
      state_idle();
      break;
  }
}

float mapfloat(float x, float in_min, float in_max, float out_min, float out_max)
{
  return (x - in_min) * (out_max - out_min) / (in_max - in_min) + out_min;
}

void readSensors()
{
  //volt = mapfloat(analogRead(volt_analog_pin), 0, 1023, 0, 5);
  //amps = mapfloat(analogRead(amps_analog_pin), 0, 1023, -30, 30);

  //0.0049*66 mV
  float averageAmps = 0;
  for (int i = 0; i < muestras; i++) {
    averageAmps = averageAmps + 1.158 * mapfloat(analogRead(amps_analog_pin), 0, 1023, -30, 30) / muestras;
    //delay(1);
  }

  float averageVolt = 0;
  for (int i = 0; i < muestras; i++) {
    averageVolt = averageVolt + mapfloat(analogRead(volt_analog_pin), 0, 1023, 0, 5) / muestras;
    //delay(1);
  }

  //CALIBRACIÓN
  //Ajustes sacados por excel -> Rectas de regresión lineal
  amps = (averageAmps + 0.0422)/0.9478;
  volt = (averageVolt + 0.0213)/1.023;
}

String timeToHuman(unsigned long milliseconds)
{
  String timeString = "";
  unsigned int seconds = (unsigned int) ((milliseconds /  1000) % 60);
  unsigned int minutes = (unsigned int) ((milliseconds / 60000) % 60);
  long    hours   = (long)(milliseconds / 3600000);

  timeString =  (hours   < 10) ? ("0" + (String) hours  ) : ((String) hours  );
  timeString += ":";
  timeString += (minutes < 10) ? ("0" + (String) minutes) : ((String) minutes);
  timeString += ":";
  timeString += (seconds < 10) ? ("0" + (String) seconds) : ((String) seconds);

  return timeString;
}
